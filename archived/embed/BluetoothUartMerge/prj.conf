## prj.conf
```kconfig
CONFIG_GPIO=y
CONFIG_SYSTEM_WORKQUEUE_STACK_SIZE=2048

CONFIG_BT_SETTINGS=y
CONFIG_FLASH=y
CONFIG_FLASH_MAP=y
CONFIG_NVS=y
CONFIG_SETTINGS=y
CONFIG_HWINFO=y

CONFIG_BT=y
CONFIG_BT_L2CAP_TX_BUF_COUNT=5
CONFIG_BT_PERIPHERAL=y
CONFIG_BT_OBSERVER=y
CONFIG_BT_BROADCASTER=y

CONFIG_BT_CTLR_DUP_FILTER_LEN=0
CONFIG_BT_CTLR_LE_ENC=n
CONFIG_BT_CTLR_LE_PING=n
CONFIG_BT_DATA_LEN_UPDATE=n
CONFIG_BT_PHY_UPDATE=n
CONFIG_BT_CTLR_MIN_USED_CHAN=n
CONFIG_BT_CTLR_PRIVACY=n
CONFIG_BT_CTLR_CHAN_SEL_2=n

CONFIG_BT_MESH=y
CONFIG_BT_MESH_MODEL_EXTENSIONS=y
CONFIG_BT_MESH_RELAY=y
CONFIG_BT_MESH_FRIEND=y
CONFIG_BT_MESH_PB_GATT=y
CONFIG_BT_MESH_PB_ADV=y
CONFIG_BT_MESH_GATT_PROXY=y

CONFIG_GPIO=y
CONFIG_UART_INTERRUPT_DRIVEN=y
CONFIG_STDOUT_CONSOLE=y

#CONFIG_BT_MESH_PROV_OOB_PUBLIC_KEY=y

#CONFIG_BT_MESH_PROV=n
#CONFIG_BT_MESH_PB_ADV=n
#CONFIG_BT_MESH_PB_GATT=n
#CONFIG_BT_MESH_PROV_DEVICE=n
#CONFIG_BT_MESH_PROVISIONER=y

CONFIG_BT_MESH_SUBNET_COUNT=2
CONFIG_BT_MESH_APP_KEY_COUNT=2
CONFIG_BT_MESH_MODEL_GROUP_COUNT=2
CONFIG_BT_MESH_LABEL_COUNT=3
# I don't know if this is all necessary but without it definitely didn't work
```

## boards/nucleo_f091rc.overlay
```dts
&usart2{
	pinctrl-0 = <&usart2_tx_pa2 &usart2_rx_pa3>;
	pinctrl-names = "default";
	current-speed = <115200>;
	status = "okay";
};

/ {
	aliases {
	usart = &usart2;
	};
};
```

## src/groupData.c
```c
#include "groupData.h"

#include <zephyr/sys/printk.h>
#include <string.h>
#include <zephyr/kernel.h>

// Defines group strings
char groups[MAX_GROUPS_ALLOWED][MAX_INFO_STRING_LENGTH];

// Empty max string
char EMPTY_MAX_NAME[MAX_NAME_LENGTH];

// MAX name empty string
void createEmptyMax()
{
    for (int i = 0; i < MAX_NAME_LENGTH; i++)
    {
        if (i < MAX_NAME_LENGTH - 1)
        {
            EMPTY_MAX_NAME[i] = '_';
        }
        else
        {
            EMPTY_MAX_NAME[i] = '\0';
        }
    }
}

// Sends groups to application
void groupsToPc(struct Group *group)
{
    // printk("%s", groups[0]);
    for (int i = 0; i < MAX_GROUPS_ALLOWED; i++)
    {
        if (group[i].groupFilled == '1')
        {
            printk("AddGroup %s ", group[i].groupName);

            //print all sensors
            for (int s = 0; s < MAX_SENSORS_IN_GROUP; s++)
            {
                if(group[i].sensors[s].sensorFilled = '1')
                {
                    printk("AddSensor %s %s %s ", group[i].sensors[s].nodeName, group[i].sensors[s].sensorType, group[i].sensors[s].sensorName);
                }
            }

            //print all actuators
            for (int a = 0; a < MAX_SENSORS_IN_GROUP; a++)
            {
                if(group[i].actuators[a].actuatorFilled = '1')
                {
                     printk("AddActuator %s %s %s ", group[i].actuators[a].nodeName, group[i].actuators[a].actuatorType, group[i].actuators[a].actuatorName);
                }
            }

            printk("\n");

            k_msleep(5);
        }
    }
}

// Add a Group
void addGroup(struct Group *group, char *groupString)
{
    int free = 0;
    char filled = '0';
    while (group[free].groupFilled == '1' && free < MAX_GROUPS_ALLOWED)
    {
        if (strstr(groupString, group[free].groupName))
        {
            filled = '1';
            break;
        }

        free++;
    }

    if (group[free].groupFilled == '0' && filled != '1')
    {
        if (strstr(groupString, "AddGroup"))
        {
            char *keyword = "AddGroup ";
            char *position = strstr(groupString, keyword);

            // Move the pointer to the start of groupName (8 characters after "AddGroup")
            position += strlen(keyword);

            // Copy the groupName into the group structure
            strncpy(group[free].groupName, position, MAX_NAME_LENGTH - 1);
            group[free].groupName[MAX_NAME_LENGTH - 1] = '\0'; // Ensure null-termination

            // Add a new sensor to the group
            keyword = "AddSensor ";
            if (strstr(groupString, keyword))
            {
                int sensorFree = 0;
                while (group[free].sensors[sensorFree].sensorFilled != '0' && sensorFree < MAX_SENSORS_IN_GROUP)
                {
                    sensorFree++;
                }

                if (sensorFree < MAX_SENSORS_IN_GROUP)
                {
                    position = strstr(groupString, keyword);
                    position += strlen(keyword);

                    // Copy the sensorType into the node structure
                    strncpy(group[free].sensors[sensorFree].nodeName, position, MAX_NAME_LENGTH - 1);
                    group[free].sensors[sensorFree].nodeName[MAX_NAME_LENGTH - 1] = '\0'; // Ensure null-termination

                    // Copy the sensorType into the group structure
                    position += MAX_NAME_LENGTH;
                    strncpy(group[free].sensors[sensorFree].sensorType, position, MAX_NAME_LENGTH - 1);
                    group[free].sensors[sensorFree].sensorType[MAX_NAME_LENGTH - 1] = '\0'; // Ensure null-termination

                    // Copy the sensorName into the node structure
                    position += MAX_NAME_LENGTH;
                    strncpy(group[free].sensors[sensorFree].sensorName, position, MAX_NAME_LENGTH - 1);
                    group[free].sensors[sensorFree].sensorName[MAX_NAME_LENGTH - 1] = '\0'; // Ensure null-termination

                    group[free].sensors[sensorFree].sensorFilled = '1';
                }
            }

            // Add a new actuator to the group
            keyword = "AddActuator ";
            if (strstr(groupString, keyword))
            {
                position = strstr(groupString, keyword);
                position += strlen(keyword);

                // Copy the actuatorType into the node structure
                strncpy(group[free].actuators[0].nodeName, position, MAX_NAME_LENGTH - 1);
                group[free].actuators[0].nodeName[MAX_NAME_LENGTH - 1] = '\0'; // Ensure null-termination

                // Copy the actuatorName into the node structure
                position += MAX_NAME_LENGTH;
                strncpy(group[free].actuators[0].actuatorType, position, MAX_NAME_LENGTH - 1);
                group[free].actuators[0].actuatorType[MAX_NAME_LENGTH - 1] = '\0'; // Ensure null-termination

                // Copy the actuatorState into the node structure
                position += MAX_NAME_LENGTH;
                strncpy(group[free].actuators[0].actuatorName, position, MAX_NAME_LENGTH - 1);
                group[free].actuators[0].actuatorName[MAX_NAME_LENGTH - 1] = '\0'; // Ensure null-termination

                group[free].actuators[0].actuatorFilled = '1';
            }

            group[free].groupFilled = '1';
        }
        else
        {
            printk("Group not available");
        }
    }
}

// Create a new group
void createGroup(struct Group *group, char *groupString)
{
    // Check for the first availble slot for the new group
    int free = 0;
    char filled = '0';
    while (group[free].groupFilled == '1' && free < MAX_GROUPS_ALLOWED)
    {
        if (strstr(groupString, group[free].groupName))
        {
            filled = '1';
            break;
        }

        free++;
    }

    // Enter the new group name
    if (group[free].groupFilled == '0' && filled != '1')
    {
        if (strstr(groupString, "CreateGroup"))
        {
            char *keyword = "CreateGroup ";
            char *position = strstr(groupString, keyword);

            // Move the pointer to the start of groupName (8 characters after "AddGroup")
            position += strlen(keyword);

            // Copy the groupName into the group structure
            strncpy(group[free].groupName, position, MAX_NAME_LENGTH - 1);
            group[free].groupName[MAX_NAME_LENGTH - 1] = '\0'; // Ensure null-termination
            group[free].groupFilled = '1';

            // Fills the empty string with '_"
            createEmptyMax();

            // Fills all sensor data with empty info
            for (int i = 0; i < MAX_SENSORS_IN_GROUP; i++)
            {
                strcpy(group[free].sensors[i].nodeName, EMPTY_MAX_NAME);
                strcpy(group[free].sensors[i].sensorType, EMPTY_MAX_NAME);
                strcpy(group[free].sensors[i].sensorName, EMPTY_MAX_NAME);
                group[free].sensors[i].sensorFilled = '0';
            }

            // Fills all actuator data with empty info
            for (int i = 0; i < MAX_ACTUATORS_IN_GROUP; i++)
            {
                strcpy(group[free].actuators[i].nodeName, EMPTY_MAX_NAME);
                strcpy(group[free].actuators[i].actuatorType, EMPTY_MAX_NAME);
                strcpy(group[free].actuators[i].actuatorName, EMPTY_MAX_NAME);
                group[free].actuators[i].actuatorFilled = '0';
            }
        }
    }
    else
    {
        // Group already exist
        // printk("This group already exist");
    }
}

// Add sensor or actuator
void updateGroup(struct Group *group, char *groupString)
{
    int check = 0;
    while (!strstr(groupString, group[check].groupName) && check < MAX_GROUPS_ALLOWED)
    {
        check++;
    }

    // Add a sensor
    char *keyword = "AddSensor ";
    if (strstr(groupString, keyword))
    {
        char *position = strstr(groupString, keyword);
        int sensorFree = 0;
        while (group[check].sensors[sensorFree].sensorFilled != '0' && sensorFree < MAX_SENSORS_IN_GROUP)
        {
            sensorFree++;
        }

        if (sensorFree < MAX_SENSORS_IN_GROUP)
        {
            position = strstr(groupString, keyword);
            position += strlen(keyword);

            // Copy the sensorType into the node structure
            strncpy(group[check].sensors[sensorFree].nodeName, position, MAX_NAME_LENGTH - 1);
            group[check].sensors[sensorFree].nodeName[MAX_NAME_LENGTH - 1] = '\0'; // Ensure null-termination

            // Copy the sensorType into the group structure
            position += MAX_NAME_LENGTH;
            strncpy(group[check].sensors[sensorFree].sensorType, position, MAX_NAME_LENGTH - 1);
            group[check].sensors[sensorFree].sensorType[MAX_NAME_LENGTH - 1] = '\0'; // Ensure null-termination

            // Copy the sensorName into the node structure
            position += MAX_NAME_LENGTH;
            strncpy(group[check].sensors[sensorFree].sensorName, position, MAX_NAME_LENGTH - 1);
            group[check].sensors[sensorFree].sensorName[MAX_NAME_LENGTH - 1] = '\0'; // Ensure null-termination

            group[check].sensors[sensorFree].sensorFilled = '1';
        }
    }

    // Add a Actuator
    keyword = "AddActuator ";

    if (strstr(groupString, keyword))
    {
        char *position = strstr(groupString, keyword);
        int actuatorFree = 0;
        while (group[check].actuators[actuatorFree].actuatorFilled != '0' && actuatorFree < MAX_ACTUATORS_IN_GROUP)
        {
            actuatorFree++;
        }

        if (actuatorFree < MAX_ACTUATORS_IN_GROUP)
        {
            position = strstr(groupString, keyword);
            position += strlen(keyword);

            // Copy the sensorType into the node structure
            strncpy(group[check].actuators[actuatorFree].nodeName, position, MAX_NAME_LENGTH - 1);
            group[check].actuators[actuatorFree].nodeName[MAX_NAME_LENGTH - 1] = '\0'; // Ensure null-termination

            // Copy the sensorType into the group structure
            position += MAX_NAME_LENGTH;
            strncpy(group[check].actuators[actuatorFree].actuatorType, position, MAX_NAME_LENGTH - 1);
            group[check].actuators[actuatorFree].actuatorType[MAX_NAME_LENGTH - 1] = '\0'; // Ensure null-termination

            // Copy the sensorName into the node structure
            position += MAX_NAME_LENGTH;
            strncpy(group[check].actuators[actuatorFree].actuatorName, position, MAX_NAME_LENGTH - 1);
            group[check].actuators[actuatorFree].actuatorName[MAX_NAME_LENGTH - 1] = '\0'; // Ensure null-termination

            group[check].actuators[actuatorFree].actuatorFilled = '1';
        }
    }
}

// Delete a group
void deleteGroup(struct Group *group, char *Message)
{
    char *keyword = "DeleteGroup ";
    if (strstr(Message, keyword))
    {
        int selected = 0;
        while (!strstr(Message, group[selected].groupName) && selected < MAX_GROUPS_ALLOWED)
        {
            selected++;
        }

        strcpy(group[selected].groupName, EMPTY_MAX_NAME); // So no accidental name comparison is going to block something
        group[selected].groupFilled = '0';                 // So it can be filled again

        // Reset sensor so we can check if a sensor has already been added
        for (int s = 0; s < MAX_SENSORS_IN_GROUP; s++)
        {
            strcpy(group[selected].sensors[s].nodeName, EMPTY_MAX_NAME);
            strcpy(group[selected].sensors[s].sensorType, EMPTY_MAX_NAME);
            strcpy(group[selected].sensors[s].sensorName, EMPTY_MAX_NAME);
            group[selected].sensors[s].sensorFilled = '0';
        }

        // Reset actuator so we can check if a actuator has already been added
        for (int a = 0; a < MAX_ACTUATORS_IN_GROUP; a++)
        {
            strcpy(group[selected].actuators[a].nodeName, EMPTY_MAX_NAME);
            strcpy(group[selected].actuators[a].actuatorType, EMPTY_MAX_NAME);
            strcpy(group[selected].actuators[a].actuatorName, EMPTY_MAX_NAME);
            group[selected].actuators[a].actuatorFilled = '0';
        }
    }
}

// Delete a sensor
void deleteSensor(struct Group *group, char *Message)
{
    char *keyword = "DeleteSensor ";
    if (strstr(Message, keyword))
    {
        int selected = 0;
        while (!strstr(Message, group[selected].groupName) && selected < MAX_GROUPS_ALLOWED)
        {
            selected++;
        }
        int sensor = 0;
        while (!strstr(Message, group[selected].sensors[sensor].sensorName) && sensor < MAX_SENSORS_IN_GROUP)
        {
            sensor++;
        }
        if (strstr(Message, group[selected].sensors[sensor].sensorName))
        {
            strcpy(group[selected].sensors[sensor].nodeName, EMPTY_MAX_NAME);
            strcpy(group[selected].sensors[sensor].sensorType, EMPTY_MAX_NAME);
            strcpy(group[selected].sensors[sensor].sensorName, EMPTY_MAX_NAME);
            group[selected].sensors[sensor].sensorFilled = '0';
        }
    }
}

// Delete a actuator
void deleteActuator(struct Group *group, char *Message)
{
    char *keyword = "DeleteActuator ";
    if (strstr(Message, keyword))
    {
        int selected = 0;
        while (!strstr(Message, group[selected].groupName) && selected < MAX_GROUPS_ALLOWED)
        {
            selected++;
        }
        int actuator = 0;
        while (!strstr(Message, group[selected].actuators[actuator].actuatorName) && actuator < MAX_SENSORS_IN_GROUP)
        {
            actuator++;
        }
        if (strstr(Message, group[selected].actuators[actuator].actuatorName))
        {
            strcpy(group[selected].actuators[actuator].nodeName, EMPTY_MAX_NAME);
            strcpy(group[selected].actuators[actuator].actuatorType, EMPTY_MAX_NAME);
            strcpy(group[selected].actuators[actuator].actuatorName, EMPTY_MAX_NAME);
            group[selected].actuators[actuator].actuatorFilled = '0';
        }
    }
}
```
