## CMakeLists.txt
```
#
# Copyright (c) 2019 Nordic Semiconductor ASA
#
# SPDX-License-Identifier: LicenseRef-Nordic-5-Clause
#
cmake_minimum_required(VERSION 3.20.0)

find_package(Zephyr REQUIRED HINTS $ENV{ZEPHYR_BASE})
project(NONE)

include_directories(
	${ZEPHYR_NRF_MODULE_DIR}/samples/bluetooth/mesh/common
)

# NORDIC SDK APP START
target_sources(app PRIVATE
	src/main.c
	src/model_handler.c)
target_include_directories(app PRIVATE
	include
	${ZEPHYR_NRF_MODULE_DIR}/samples/bluetooth/mesh/common
)

# Preinitialization related to DFU over SMP for nRF52 series
if(CONFIG_SOC_SERIES_NRF52X)
  target_sources_ifdef(CONFIG_MCUMGR_TRANSPORT_BT app PRIVATE
    ${ZEPHYR_NRF_MODULE_DIR}/samples/bluetooth/mesh/common/smp_bt.c)
endif()

# NORDIC SDK APP END
```

## Kconfig.sysbuild
```
#
# Copyright (c) 2023 Nordic Semiconductor
#
# SPDX-License-Identifier: LicenseRef-Nordic-5-Clause
#

source "${ZEPHYR_BASE}/share/sysbuild/Kconfig"

config NRF_DEFAULT_BLUETOOTH
	default y
config BT_MESH_CFG_CLI
    bool "Support for Configuration Client Model"
    depends on BT_MESH && BT
    help
      Enable support for the configuration client model.
```

## sample.yaml
```
sample:
  description: Bluetooth mesh light sample
  name: Bluetooth mesh light
tests:
  sample.bluetooth.mesh.light:
    build_only: true
    integration_platforms:
      - nrf52dk_nrf52832
      - nrf52840dk_nrf52840
      - nrf52833dk_nrf52833
      - nrf5340dk_nrf5340_cpuapp
      - nrf5340dk_nrf5340_cpuapp_ns
      - thingy53_nrf5340_cpuapp
      - nrf21540dk_nrf52840
    platform_allow: nrf52dk_nrf52832 nrf52840dk_nrf52840 nrf5340dk_nrf5340_cpuapp
      nrf5340dk_nrf5340_cpuapp_ns thingy53_nrf5340_cpuapp
      nrf21540dk_nrf52840 nrf52833dk_nrf52833
    tags: bluetooth ci_build
  sample.bluetooth.mesh.light.dfu:
    build_only: true
    integration_platforms:
      - nrf52840dk_nrf52840
      - nrf21540dk_nrf52840
    platform_allow: nrf52840dk_nrf52840 nrf21540dk_nrf52840
    extra_args: OVERLAY_CONFIG=overlay-dfu.conf
    tags: bluetooth ci_build
```

## prj.conf
```kconfig
#
# Copyright (c) 2019 Nordic Semiconductor ASA
#
# SPDX-License-Identifier: LicenseRef-Nordic-5-Clause
#
#CONFIG_NCS_SAMPLES_DEFAULTS=y
CONFIG_GPIO=y
CONFIG_UART_INTERRUPT_DRIVEN=y
CONFIG_STDOUT_CONSOLE=y

# Deffered logging helps improve LPN power consumption
# when friendship is established.
CONFIG_LOG_MODE_DEFERRED=y

# General configuration
CONFIG_SYSTEM_WORKQUEUE_STACK_SIZE=2048
CONFIG_FLASH=y
CONFIG_FLASH_MAP=y
CONFIG_NVS=y
CONFIG_SETTINGS=y
CONFIG_HWINFO=y
#CONFIG_DK_LIBRARY=y
#CONFIG_PM_SINGLE_IMAGE=y
#CONFIG_PM_PARTITION_SIZE_SETTINGS_STORAGE=0x8000
CONFIG_SOC_FLASH_NRF_PARTIAL_ERASE=y

# Bluetooth configuration
CONFIG_BT=y
CONFIG_BT_COMPANY_ID=0x0059
CONFIG_BT_DEVICE_NAME="Mesh Light"
CONFIG_BT_L2CAP_TX_BUF_COUNT=8

CONFIG_BT_OBSERVER=y
CONFIG_BT_PERIPHERAL=y
CONFIG_BT_SETTINGS=y

# Increase RX stack size to avoid overflow during provisioning
CONFIG_BT_RX_STACK_SIZE=2700

# Disable unused Bluetooth features
CONFIG_BT_CTLR_DUP_FILTER_LEN=0
CONFIG_BT_CTLR_LE_ENC=n
CONFIG_BT_PHY_UPDATE=n
CONFIG_BT_CTLR_CHAN_SEL_2=n
CONFIG_BT_CTLR_MIN_USED_CHAN=n
CONFIG_BT_CTLR_PRIVACY=n

# Bluetooth mesh configuration
CONFIG_BT_MESH=y
CONFIG_BT_MESH_RELAY=y
CONFIG_BT_MESH_FRIEND=y
CONFIG_BT_MESH_TX_SEG_MAX=10
CONFIG_BT_MESH_PB_GATT=y
CONFIG_BT_MESH_GATT_PROXY=y
CONFIG_BT_MESH_PROXY_USE_DEVICE_NAME=y
#CONFIG_BT_MESH_DK_PROV=y
CONFIG_BT_MESH_CFG_CLI=y

# Bluetooth mesh models
#CONFIG_BT_MESH_ONOFF_SRV=y
```

## overlay-dfu.conf
```kconfig
#
# Copyright (c) 2022 Nordic Semiconductor ASA
#
# SPDX-License-Identifier: LicenseRef-Nordic-5-Clause
#

# Enable point to point DFU over SMP
CONFIG_BOOTLOADER_MCUBOOT=y
CONFIG_NCS_SAMPLE_MCUMGR_BT_OTA_DFU=y
CONFIG_NCS_SAMPLE_MCUMGR_BT_OTA_DFU_SPEEDUP=y

# Enable Extended Advertiser to advertise BT SMP service
CONFIG_BT_EXT_ADV=y
CONFIG_BT_EXT_ADV_MAX_ADV_SET=6

# One extra connection for mesh GATT/proxy and one for SMP BT.
CONFIG_BT_MAX_CONN=3

# One extra identity for SMP service
CONFIG_BT_ID_MAX=2
```

## src/main.c
```c
/*
 * Copyright (c) 2019 Nordic Semiconductor ASA
 *
 * SPDX-License-Identifier: LicenseRef-Nordic-5-Clause
 */

/** @file
 *  @brief Nordic mesh light sample
 */
#include <zephyr/bluetooth/bluetooth.h>
#include <bluetooth/mesh/models.h>
#include <bluetooth/mesh/dk_prov.h>
#include <dk_buttons_and_leds.h>
#include "model_handler.h"
#include "smp_bt.h"
#include <zephyr/bluetooth/mesh/access.h>
#include <stdint.h>
#include <stdbool.h>
#include <zephyr/bluetooth/mesh/cfg_cli.h>
#include <zephyr/drivers/gpio.h>
#define SLEEP_TIME_MS	1
//test
/*
 * Get button configuration from the devicetree sw0 alias. This is mandatory.
 */
#define SW0_NODE	DT_ALIAS(sw0)
#if !DT_NODE_HAS_STATUS(SW0_NODE, okay)
#error "Unsupported board: sw0 devicetree alias is not defined"
#endif
static const struct gpio_dt_spec button = GPIO_DT_SPEC_GET_OR(SW0_NODE, gpios,
							      {0});
static struct gpio_callback button_cb_data;
/*
 * The led0 devicetree alias is optional. If present, we'll use it
 * to turn on the LED whenever the button is pressed.
 */
static struct gpio_dt_spec led = GPIO_DT_SPEC_GET_OR(DT_ALIAS(led0), gpios,
						     {0});

void boardOutputNumber(bt_mesh_output_action_t action, uint32_t number)
{

}

void boardProvComplete(void)
{
}
/* Provisioning */
static int output_number(bt_mesh_output_action_t action, uint32_t number)
{
	printk("OOB Number: %u\n", number);

	boardOutputNumber(action, number);

	return 0;
}

void clear_provisioning_data(void)
{
    int err;

    // Clear provisioning data from settings
    err = settings_delete("bt/mesh");
    if (err) {
        printk("Failed to clear provisioning data (err %d)\n", err);
        return;
    }

    printk("Provisioning data cleared\n");
}
static void prov_complete(uint16_t net_idx, uint16_t addr)
{
	extern uint16_t extern_net_idx;
	extern uint16_t extern_addr;
	extern_net_idx = net_idx;
	extern_addr = addr;
	boardProvComplete();
	printk("Provisioning completed. Network Index: 0x%04x, Address: 0x%04x\n",
           net_idx, addr);

}

static void prov_reset(void)
{
	bt_mesh_prov_disable(BT_MESH_PROV_ADV | BT_MESH_PROV_GATT | BT_MESH_PROV_REMOTE);//disable mesh provisioning
	clear_provisioning_data();//reset provisioning data
	bt_mesh_prov_enable(BT_MESH_PROV_ADV | BT_MESH_PROV_GATT);
	//bt_mesh_prov_enable(BT_MESH_PROV_ADV | BT_MESH_PROV_GATT);
}
static uint8_t dev_uuid[16];
static const struct bt_mesh_prov prov = {
	.uuid = dev_uuid,
	.output_size = 4,
	.output_actions = BT_MESH_DISPLAY_NUMBER,
	.output_number = output_number,
	.complete = prov_complete,
	.reset = prov_reset,
};

static void bt_ready(int err)
{
	if (err) {
		printk("Bluetooth init failed (err %d)\n", err);
		return;
	}

	printk("Bluetooth initialized\n");

	dk_leds_init();
	dk_buttons_init(NULL);
    printk("Led en Buttons initialized\n");

	err = bt_mesh_init(&prov, model_handler_init());
	if (err) {
		printk("Initializing mesh failed (err %d)\n", err);
		return;
	}
    printk("Mesh provision initialized\n");

	if (IS_ENABLED(CONFIG_SETTINGS)) {
		settings_load();
		printk("settings : %d\n",settings_load());
	}

	/* This will be a no-op if settings_load() loaded provisioning info */
	bt_mesh_prov_enable(BT_MESH_PROV_ADV | BT_MESH_PROV_GATT);

	printk("Mesh initialized\n");

	if (IS_ENABLED(CONFIG_SOC_SERIES_NRF52X) && IS_ENABLED(CONFIG_MCUMGR_TRANSPORT_BT)) {
		err = smp_dfu_init();
		if (err) {
			printk("Unable to initialize DFU (err %d)\n", err);
		}
	}
	printk("end bt_ready\n");
}
int buttoncount = 0;
uint16_t extern_net_idx = 0;
uint16_t extern_addr = 0;
void getNetIdx(uint16_t *input)
{
	extern uint16_t extern_net_idx;
	*input = extern_net_idx;
}
void getAddr(uint16_t *input)
{
	extern uint16_t extern_addr;
	*input = extern_addr;
}
void subscribe(uint16_t net_idx, uint16_t addr,uint16_t elem_addr,uint16_t sub_addr,uint16_t mod_id)
{
	int err;
	uint8_t status = 0;

	err = bt_mesh_cfg_cli_mod_sub_add(net_idx, addr, elem_addr, sub_addr, mod_id,&status);
	if (err) {
		printk("sub failed (err %d)\n", err);
	}
	printk("Sub Network Index: 0x%04x, Address: 0x%04x\n",
           net_idx, addr);
	printk("Sub add (err: %d, status: %d)\n", err,
				   status);
				   
}
void button_pressed(const struct device *dev, struct gpio_callback *cb,
		    uint32_t pins)
{
	uint16_t button_net_idx = 0;
	uint16_t button_addr = 0;
	getNetIdx(&button_net_idx);
	getAddr(&button_addr);
	printk("Button pressed at %" PRIu32 "\n", k_cycle_get_32());
	//printk("Button pressed net_idx: 0x%04x and addr: 0x%04x\n", button_net_idx, button_addr);
	uint16_t elem_addr = button_addr;
	uint16_t sub_addr = 0xC001;
	uint16_t mod_id = 0x1000;
	int err;
	uint8_t status;
	printk("Button pressed net_idx: 0x%04x, addr: 0x%04x, elem_addr: 0x%04x, sub_addr: 0x%04x and mod_id: 0x%04x\n",
	button_net_idx, button_addr,elem_addr,sub_addr,mod_id);
	if(elem_addr = 0)
	{
		printk("no addres found");
	}
	else{
		/*err = bt_mesh_cfg_cli_mod_sub_add(button_net_idx, button_addr, elem_addr, sub_addr, mod_id,
												  &status);
		if (err) {
		printk("sub failed (err %d)\n", err);
		}*/
	}
	extern int buttoncount;
	buttoncount = buttoncount + 1;
	printk("button count: %d\n",buttoncount);
	if(buttoncount == 10)
	{
		printk("run subscribe function\n");
		//subscribe(button_net_idx, button_addr, elem_addr, sub_addr, mod_id);
		err = bt_mesh_cfg_cli_mod_sub_add(button_net_idx, button_addr, elem_addr, sub_addr, mod_id,
												  &status);
		if (err) {
		printk("sub failed (err %d)\n", err);
		}
	}
	return;
}
static void button_init(void)
{
	int ret;

	if (!gpio_is_ready_dt(&button)) {
		printk("Error: button device %s is not ready\n",
		       button.port->name);
		return 0;
	}

	ret = gpio_pin_configure_dt(&button, GPIO_INPUT);
	if (ret != 0) {
		printk("Error %d: failed to configure %s pin %d\n",
		       ret, button.port->name, button.pin);
		return 0;
	}

	ret = gpio_pin_interrupt_configure_dt(&button,
					      GPIO_INT_EDGE_TO_ACTIVE);
	if (ret != 0) {
		printk("Error %d: failed to configure interrupt on %s pin %d\n",
			ret, button.port->name, button.pin);
		return 0;
	}

	gpio_init_callback(&button_cb_data, button_pressed, BIT(button.pin));
	gpio_add_callback(button.port, &button_cb_data);
	printk("Set up button at %s pin %d\n", button.port->name, button.pin);

	if (led.port && !gpio_is_ready_dt(&led)) {
		printk("Error %d: LED device %s is not ready; ignoring it\n",
		       ret, led.port->name);
		led.port = NULL;
	}
	if (led.port) {
		ret = gpio_pin_configure_dt(&led, GPIO_OUTPUT);
		if (ret != 0) {
			printk("Error %d: failed to configure LED device %s pin %d\n",
			       ret, led.port->name, led.pin);
			led.port = NULL;
		} else {
			printk("Set up LED at %s pin %d\n", led.port->name, led.pin);
		}
	}
}
int main(void)
{
	int err;
	extern uint16_t extern_net_idx;
	extern uint16_t extern_addr;
	printk("Initializing...\n");

	err = bt_enable(bt_ready);
	if (err) {
		printk("Bluetooth init failed (err %d)\n", err);
	}
	
	printk("bt_ready ok\n");
	button_init();
	printk("Press the button\n");
	return 0;
	printk("End Main\n");
}
```

## src/extern_var.c
```c
#include "extern_var.h"

uint16_t extern_net_idx = 0;
uint16_t extern_addr = 0;

void SetNetidx(uint16_t input)
{
    extern_net_idx = input;
}

void SetAddr(uint16_t input)
{
    extern_addr = input;
}
```

## src/extern_var.h
```c
#include <stdint.h>
#include <stdbool.h>

extern uint16_t extern_net_idx;
extern uint16_t extern_addr;

void SetNetidx(uint16_t input);
void SetAddr(uint16_t input);
```

## src/model_handler.c
```c
/*
 * Copyright (c) 2019 Nordic Semiconductor ASA
 *
 * SPDX-License-Identifier: LicenseRef-Nordic-5-Clause
 */

#include <zephyr/bluetooth/bluetooth.h>
#include <bluetooth/mesh/models.h>
#include <dk_buttons_and_leds.h>
#include "model_handler.h"

static void led_set(struct bt_mesh_onoff_srv *srv, struct bt_mesh_msg_ctx *ctx,
		    const struct bt_mesh_onoff_set *set,
		    struct bt_mesh_onoff_status *rsp);

static void led_get(struct bt_mesh_onoff_srv *srv, struct bt_mesh_msg_ctx *ctx,
		    struct bt_mesh_onoff_status *rsp);

static const struct bt_mesh_onoff_srv_handlers onoff_handlers = {
	.set = led_set,
	.get = led_get,
};

struct led_ctx {
	struct bt_mesh_onoff_srv srv;
	struct k_work_delayable work;
	uint32_t remaining;
	bool value;
};

static struct led_ctx led_ctx[] = {
#if DT_NODE_EXISTS(DT_ALIAS(led0))
	{ .srv = BT_MESH_ONOFF_SRV_INIT(&onoff_handlers) },
#endif
#if DT_NODE_EXISTS(DT_ALIAS(led1))
	{ .srv = BT_MESH_ONOFF_SRV_INIT(&onoff_handlers) },
#endif
#if DT_NODE_EXISTS(DT_ALIAS(led2))
	{ .srv = BT_MESH_ONOFF_SRV_INIT(&onoff_handlers) },
#endif
#if DT_NODE_EXISTS(DT_ALIAS(led3))
	{ .srv = BT_MESH_ONOFF_SRV_INIT(&onoff_handlers) },
#endif
};

static void led_transition_start(struct led_ctx *led)
{
	int led_idx = led - &led_ctx[0];

	/* As long as the transition is in progress, the onoff
	 * state is "on":
	 */
	dk_set_led(led_idx, true);
	k_work_reschedule(&led->work, K_MSEC(led->remaining));
	led->remaining = 0;
}

static void led_status(struct led_ctx *led, struct bt_mesh_onoff_status *status)
{
	/* Do not include delay in the remaining time. */
	status->remaining_time = led->remaining ? led->remaining :
		k_ticks_to_ms_ceil32(k_work_delayable_remaining_get(&led->work));
	status->target_on_off = led->value;
	/* As long as the transition is in progress, the onoff state is "on": */
	status->present_on_off = led->value || status->remaining_time;
}

static void led_set(struct bt_mesh_onoff_srv *srv, struct bt_mesh_msg_ctx *ctx,
		    const struct bt_mesh_onoff_set *set,
		    struct bt_mesh_onoff_status *rsp)
{
	struct led_ctx *led = CONTAINER_OF(srv, struct led_ctx, srv);
	int led_idx = led - &led_ctx[0];

	if (set->on_off == led->value) {
		goto respond;
	}

	led->value = set->on_off;
	if (!bt_mesh_model_transition_time(set->transition)) {
		led->remaining = 0;
		dk_set_led(led_idx, set->on_off);
		goto respond;
	}

	led->remaining = set->transition->time;

	if (set->transition->delay) {
		k_work_reschedule(&led->work, K_MSEC(set->transition->delay));
	} else {
		led_transition_start(led);
	}

respond:
	if (rsp) {
		led_status(led, rsp);
	}
}

static void led_get(struct bt_mesh_onoff_srv *srv, struct bt_mesh_msg_ctx *ctx,
		    struct bt_mesh_onoff_status *rsp)
{
	struct led_ctx *led = CONTAINER_OF(srv, struct led_ctx, srv);

	led_status(led, rsp);
}

static void led_work(struct k_work *work)
{
	struct led_ctx *led = CONTAINER_OF(work, struct led_ctx, work.work);
	int led_idx = led - &led_ctx[0];

	if (led->remaining) {
		led_transition_start(led);
	} else {
		dk_set_led(led_idx, led->value);

		/* Publish the new value at the end of the transition */
		struct bt_mesh_onoff_status status;

		led_status(led, &status);
		bt_mesh_onoff_srv_pub(&led->srv, NULL, &status);
	}
}

/* Set up a repeating delayed work to blink the DK's LEDs when attention is
 * requested.
 */
static struct k_work_delayable attention_blink_work;
static bool attention;

static void attention_blink(struct k_work *work)
{
	static int idx;
	const uint8_t pattern[] = {
#if DT_NODE_EXISTS(DT_ALIAS(led0))
		BIT(0),
#endif
#if DT_NODE_EXISTS(DT_ALIAS(led1))
		BIT(1),
#endif
#if DT_NODE_EXISTS(DT_ALIAS(led2))
		BIT(2),
#endif
#if DT_NODE_EXISTS(DT_ALIAS(led3))
		BIT(3),
#endif
	};

	if (attention) {
		dk_set_leds(pattern[idx++ % ARRAY_SIZE(pattern)]);
		k_work_reschedule(&attention_blink_work, K_MSEC(30));
	} else {
		dk_set_leds(DK_NO_LEDS_MSK);
	}
}

static void attention_on(struct bt_mesh_model *mod)
{
	attention = true;
	k_work_reschedule(&attention_blink_work, K_NO_WAIT);
}

static void attention_off(struct bt_mesh_model *mod)
{
	/* Will stop rescheduling blink timer */
	attention = false;
}

static const struct bt_mesh_health_srv_cb health_srv_cb = {
	.attn_on = attention_on,
	.attn_off = attention_off,
};

static struct bt_mesh_health_srv health_srv = {
	.cb = &health_srv_cb,
};

BT_MESH_HEALTH_PUB_DEFINE(health_pub, 0);

static struct bt_mesh_elem elements[] = {
#if DT_NODE_EXISTS(DT_ALIAS(led0))
	BT_MESH_ELEM(
		1, BT_MESH_MODEL_LIST(
			BT_MESH_MODEL_CFG_SRV,
			BT_MESH_MODEL_HEALTH_SRV(&health_srv, &health_pub),
			BT_MESH_MODEL_ONOFF_SRV(&led_ctx[0].srv)),
		BT_MESH_MODEL_NONE),
#endif
#if DT_NODE_EXISTS(DT_ALIAS(led1))
	BT_MESH_ELEM(
		2, BT_MESH_MODEL_LIST(BT_MESH_MODEL_ONOFF_SRV(&led_ctx[1].srv)),
		BT_MESH_MODEL_NONE),
#endif
#if DT_NODE_EXISTS(DT_ALIAS(led2))
	BT_MESH_ELEM(
		3, BT_MESH_MODEL_LIST(BT_MESH_MODEL_ONOFF_SRV(&led_ctx[2].srv)),
		BT_MESH_MODEL_NONE),
#endif
#if DT_NODE_EXISTS(DT_ALIAS(led3))
	BT_MESH_ELEM(
		4, BT_MESH_MODEL_LIST(BT_MESH_MODEL_ONOFF_SRV(&led_ctx[3].srv)),
		BT_MESH_MODEL_NONE),
#endif
};

static const struct bt_mesh_comp comp = {
	.cid = CONFIG_BT_COMPANY_ID,
	.elem = elements,
	.elem_count = ARRAY_SIZE(elements),
};

const struct bt_mesh_comp *model_handler_init(void)
{
	k_work_init_delayable(&attention_blink_work, attention_blink);

	for (int i = 0; i < ARRAY_SIZE(led_ctx); ++i) {
		k_work_init_delayable(&led_ctx[i].work, led_work);
	}

	return &comp;
}
```

## src/subscribe.c
```c
#include "subscribe.h"

void subscribe(uint16_t net_idx, uint16_t addr,uint16_t elem_addr,uint16_t sub_addr,uint16_t mod_id)
{
	int err;
	uint8_t status = 0;

	err = bt_mesh_cfg_cli_mod_sub_add(net_idx, addr, elem_addr, sub_addr, mod_id,
												  &status);
	if (err) {
		printk("sub failed (err %d)\n", err);
	}
	printk("Sub Network Index: 0x%04x, Address: 0x%04x\n",
           net_idx, addr);
	printk("Sub add (err: %d, status: %d)\n", err,
				   status);
				   
}
```

## src/subscribe.h
```c
#include <stdint.h>
#include <stdbool.h>

void subscribe(uint16_t net_idx, uint16_t addr,uint16_t elem_addr,uint16_t sub_addr,uint16_t mod_id);
```
